## boards/arm/nucleo_g070rb/Kconfig.board
```kconfig
# Kconfig - STM32 Nucleo-64 development board with STM32G070RB MCU configuration
#
# Copyright (c) 2019 Philippe Retornaz <philippe@shapescale.com>
#
# SPDX-License-Identifier: Apache-2.0
#

config BOARD_NUCLEO_G070RB
	bool "NUCLEO-64 G070RB Development Board"
	depends on SOC_STM32G070RB
```

## soc/arm/st_stm32/stm32g0/Kconfig.defconfig.stm32g070cb
```kconfig
# Kconfig - ST Microelectronics STM32G070CB MCU
#
# Copyright (c) 2019 Philippe Retornaz <philippe@shapescale.com>
#
# SPDX-License-Identifier: Apache-2.0
#

if SOC_STM32G070CB

config SOC
	string
	default "stm32g070xx"

config NUM_IRQS
	int
	default 31

endif # SOC_STM32G070CB
```

## soc/arm/st_stm32/stm32g0/Kconfig.defconfig.stm32g070rb
```kconfig
# Kconfig - ST Microelectronics STM32G070RB MCU
#
# Copyright (c) 2019 Philippe Retornaz <philippe@shapescale.com>
#
# SPDX-License-Identifier: Apache-2.0
#

if SOC_STM32G070RB

config SOC
	string
	default "stm32g070xx"

config NUM_IRQS
	int
	default 31

endif # SOC_STM32G070RB
```
